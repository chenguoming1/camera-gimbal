#include "ssd1306.h"

static uint8_t oledBuffer[OLED_WIDTH * OLED_HEIGHT / 8];

const uint8_t font5x7[95][5] = {
    {0x00,0x00,0x00,0x00,0x00},
    {0x00,0x00,0x5F,0x00,0x00},
    {0x00,0x07,0x00,0x07,0x00},
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    {0x3E,0x41,0x41,0x22,0x1C},
};

void SSD1306_WriteCmd(I2C_HandleTypeDef *hi2c, uint8_t cmd) {
    uint8_t data[2] = {SSD1306_CMD_MODE, cmd};
    HAL_I2C_Master_Transmit(hi2c, SSD1306_ADDR << 1, data, 2, 100);
}

void SSD1306_WriteData(I2C_HandleTypeDef *hi2c, uint8_t *data, uint16_t len) {
    uint8_t buffer[129];
    buffer[0] = SSD1306_DATA_MODE;
    memcpy(&buffer[1], data, len);
    HAL_I2C_Master_Transmit(hi2c, SSD1306_ADDR << 1, buffer, len + 1, 100);
}

void SSD1306_Init(I2C_HandleTypeDef *hi2c) {
    HAL_Delay(100);
    SSD1306_WriteCmd(hi2c, SSD1306_DISPLAY_OFF);
    SSD1306_WriteCmd(hi2c, 0x20);
    SSD1306_WriteCmd(hi2c, 0x10);
    SSD1306_WriteCmd(hi2c, SSD1306_DISPLAY_ON - 14);
    SSD1306_WriteCmd(hi2c, 0xB0);
    SSD1306_WriteCmd(hi2c, 0x00);
    SSD1306_WriteCmd(hi2c, 0x10);
    SSD1306_WriteCmd(hi2c, 0x40);
    SSD1306_WriteCmd(hi2c, 0x81);
    SSD1306_WriteCmd(hi2c, 0xFF);
    SSD1306_WriteCmd(hi2c, 0xA1);
    SSD1306_WriteCmd(hi2c, 0xA6);
    SSD1306_WriteCmd(hi2c, 0xA8);
    SSD1306_WriteCmd(hi2c, 0x3F);
    SSD1306_WriteCmd(hi2c, 0xC8);
    SSD1306_WriteCmd(hi2c, 0xD3);
    SSD1306_WriteCmd(hi2c, 0x00);
    SSD1306_WriteCmd(hi2c, 0xD5);
    SSD1306_WriteCmd(hi2c, 0x80);
    SSD1306_WriteCmd(hi2c, 0xD8);
    SSD1306_WriteCmd(hi2c, 0x05);
    SSD1306_WriteCmd(hi2c, 0xD9);
    SSD1306_WriteCmd(hi2c, 0xF1);
    SSD1306_WriteCmd(hi2c, 0xDA);
    SSD1306_WriteCmd(hi2c, 0x12);
    SSD1306_WriteCmd(hi2c, 0xDB);
    SSD1306_WriteCmd(hi2c, 0x30);
    SSD1306_WriteCmd(hi2c, 0x8D);
    SSD1306_WriteCmd(hi2c, 0x14);
    SSD1306_WriteCmd(hi2c, SSD1306_DISPLAY_ON);
}

void SSD1306_Clear(void) {
    memset(oledBuffer, 0, sizeof(oledBuffer));
}

void SSD1306_UpdateDisplay(I2C_HandleTypeDef *hi2c) {
    SSD1306_WriteCmd(hi2c, 0x21);
    SSD1306_WriteCmd(hi2c, 0);
    SSD1306_WriteCmd(hi2c, 127);
    SSD1306_WriteCmd(hi2c, 0x22);
    SSD1306_WriteCmd(hi2c, 0);
    SSD1306_WriteCmd(hi2c, 7);

    for (uint16_t i = 0; i < OLED_WIDTH * OLED_PAGES; i += 128) {
        SSD1306_WriteData(hi2c, &oledBuffer[i], 128);
    }
}

void SSD1306_SetPixel(uint8_t x, uint8_t y, uint8_t on) {
    if (x >= OLED_WIDTH || y >= OLED_HEIGHT) return;
    if (on) {
        oledBuffer[x + (y / 8) * OLED_WIDTH] |= (1 << (y % 8));
    } else {
        oledBuffer[x + (y / 8) * OLED_WIDTH] &= ~(1 << (y % 8));
    }
}

void SSD1306_DrawChar(uint8_t x, uint8_t y, char c) {
    if (c < ' ' || c > '~') return;
    uint8_t idx = c - ' ';
    for (uint8_t i = 0; i < 5; i++) {
        uint8_t col = font5x7[idx][i];
        for (uint8_t j = 0; j < 7; j++) {
            if (col & (1 << j)) {
                SSD1306_SetPixel(x + i, y + j, 1);
            }
        }
    }
}

void SSD1306_DrawString(uint8_t x, uint8_t y, const char *str) {
    uint8_t cursorX = x;
    while (*str) {
        SSD1306_DrawChar(cursorX, y, *str);
        cursorX += 6;
        if (cursorX >= OLED_WIDTH) break;
        str++;
    }
}

void SSD1306_DrawInt(uint8_t x, uint8_t y, int32_t value) {
    char buf[12];
    uint8_t idx = 0;

    if (value < 0) {
        SSD1306_DrawChar(x, y, '-');
        value = -value;
    } else {
        SSD1306_DrawChar(x, y, '+');
    }
    x += 6;

    if (value == 0) {
        buf[idx++] = '0';
    } else {
        char rev[12];
        uint8_t ridx = 0;
        while (value > 0) {
            rev[ridx++] = '0' + (value % 10);
            value /= 10;
        }
        while (ridx > 0) {
            buf[idx++] = rev[--ridx];
        }
    }
    buf[idx] = '\0';
    SSD1306_DrawString(x, y, buf);
}

/* ---------- Big font: 3x scaled from font5x7 ----------
 * Each character occupies 15 x 21 pixels, advance 16 px. */
void SSD1306_DrawCharBig(uint8_t x, uint8_t y, char c) {
    if (c < ' ' || c > '~') return;
    uint8_t idx = c - ' ';
    for (uint8_t col = 0; col < 5; col++) {
        uint8_t colData = font5x7[idx][col];
        for (uint8_t row = 0; row < 7; row++) {
            if (colData & (1 << row)) {
                /* Draw a 3x3 block per original pixel */
                for (uint8_t dx = 0; dx < 3; dx++) {
                    for (uint8_t dy = 0; dy < 3; dy++) {
                        SSD1306_SetPixel(x + col * 3 + dx,
                                         y + row * 3 + dy, 1);
                    }
                }
            }
        }
    }
}

void SSD1306_DrawStringBig(uint8_t x, uint8_t y, const char *str) {
    uint8_t cursorX = x;
    while (*str) {
        SSD1306_DrawCharBig(cursorX, y, *str);
        cursorX += 16;   /* 15 px wide + 1 px gap */
        if (cursorX >= OLED_WIDTH) break;
        str++;
    }
}

/* Draw a pitch angle (float, degrees) centred on the display.
 * Layout (128x64):
 *   Row 0-9  : label "Pitch" in small font, centred
 *   Row 12-54: value  e.g. "-123.4" in big font
 *   Row 56-63: unit "deg" in small font, centred           */
void SSD1306_DrawAngle(float angle) {
    /* ---- format the number: sign + 3 digits + '.' + 1 decimal ---- */
    char buf[10];
    uint8_t bIdx = 0;

    /* sign */
    if (angle < 0.0f) {
        buf[bIdx++] = '-';
        angle = -angle;
    } else {
        buf[bIdx++] = '+';
    }

    /* clamp to 999.9 */
    if (angle > 999.9f) angle = 999.9f;

    /* integer part */
    uint16_t intPart = (uint16_t)angle;
    uint8_t dec      = (uint8_t)((angle - intPart) * 10.0f);

    /* suppress leading zeros but keep at least one digit */
    uint8_t started = 0;
    uint16_t div = 100;
    while (div >= 1) {
        uint8_t digit = (intPart / div) % 10;
        if (digit || started || div == 1) {
            buf[bIdx++] = '0' + digit;
            started = 1;
        }
        div /= 10;
    }
    buf[bIdx++] = '.';
    buf[bIdx++] = '0' + dec;
    buf[bIdx]   = '\0';

    /* ---- measure string width in big font to centre it ---- */
    uint8_t numChars = bIdx;            /* total chars including sign */
    uint8_t strWidth = numChars * 16 - 1; /* last char has no trailing gap */
    uint8_t startX   = (OLED_WIDTH - strWidth) / 2;
    if (startX > OLED_WIDTH) startX = 0; /* overflow guard */

    /* ---- draw label centred on top ---- */
    const char *label = "Pitch";
    uint8_t labelW = 5 * 6 - 1;  /* 5 chars * 6px - 1 gap */
    SSD1306_DrawString((OLED_WIDTH - labelW) / 2, 0, label);

    /* ---- draw big value centred vertically in middle ---- */
    SSD1306_DrawStringBig(startX, 12, buf);

    /* ---- draw unit centred on bottom ---- */
    const char *unit = "deg";
    uint8_t unitW = 3 * 6 - 1;
    SSD1306_DrawString((OLED_WIDTH - unitW) / 2, 56, unit);
}
